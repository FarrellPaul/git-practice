## build/Kconfig/Kconfig.shield
```kconfig
osource "c:/farrellpaul_repo/bt-fund/lesson1/blefund_less1_exer1/boards/shields/*/Kconfig.shield"
osource "C:/ncs/v2.2.0/nrf/boards/shields/*/Kconfig.shield"
```

## build/Kconfig/Kconfig.shield.defconfig
```kconfig
osource "c:/farrellpaul_repo/bt-fund/lesson1/blefund_less1_exer1/boards/shields/*/Kconfig.defconfig"
osource "C:/ncs/v2.2.0/nrf/boards/shields/*/Kconfig.defconfig"
```
